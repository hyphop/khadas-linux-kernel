
// LEDS

/ {

    pwmleds {
	compatible = "pwm-leds";

	power {
	    label = "vim:white";
	    pwms = <&pwm_AO_ab 1 7812500 0>;
	    max-brightness = <255>;
	    linux,default-trigger = "default-on";
	};
    };

};