
// ## hyphop ##

#include "meson-gxm-khadas-vim2.dts"
#include "krescue-spifc.dtsi"
//#include "krescue-spi-parts.dts"
#include "krescue-leds_vim2.dtsi"
#include "krescue-vim2.dtsi"
#include "krescue-vims.dtsi"


