
// SPIFC support

&spifc {
//  status = "okay";
    status = "disabled";
    pinctrl-0 = <&nor_pins>;
    pinctrl-names = "default";

    w25q128fw: spi-flash@0 {
    #address-cells = <1>;
    #size-cells = <1>;
    compatible = "winbond,w25q128fw", "jedec,spi-nor";
    reg = <0>;
    spi-max-frequency = <104000000>;
    };
};

/ {
    aliases {
    spifc = &spifc;
    };
};

