

/ {

/delete-node/ pwmleds;

leds {
	compatible = "gpio-leds";
        status = "okay";

	led_white: white {
	    label = "vim:white";
	    gpios = <&gpio_ao GPIOAO_9 GPIO_ACTIVE_HIGH>;
	    linux,default-trigger = "heartbeat";
	};

    };

};


&pwm_AO_ab {
    status = "disabled";
};
